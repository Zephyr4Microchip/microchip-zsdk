## applications/mcuboot/mcuboot_basic/mcuboot/boards/pic32ck_gc01_cult.conf
```kconfig
# Copyright (c) 2026 Microchip Technology Inc.
# SPDX-License-Identifier: Apache-2.0
#
# MCUboot configuration for PIC32CK GC01 Curiosity Ultra.
#
# MCUboot resides in BFM (flash0, 128 KB).
# Application images reside in PFM (flash1):
#   slot0 = 1008 KB, slot1 = 1008 KB
# Erase block size = 4 KB => 252 sectors per slot.

# Flash driver is required to read/write application slots in PFM
CONFIG_FLASH=y

# Disable ROMSTART relocation: MCUboot lives entirely in flash0 (BFM),
# so vectors and code are both in flash0 -- no relocation needed.
CONFIG_ROMSTART_RELOCATION_ROM=n

# Swap mode with rollback capability (swap-using-move algorithm)
CONFIG_BOOT_SWAP_USING_MOVE=y

# Image confirmation required to make upgrade permanent
CONFIG_BOOT_BOOTSTRAP=y

# Prevent downgrade to older versions
CONFIG_MCUBOOT_DOWNGRADE_PREVENTION=y

# ECDSA-P256 signature verification (using MCUboot's built-in test key)
# Uses tinycrypt (bundled with MCUboot, no external mbedtls module needed)
CONFIG_BOOT_SIGNATURE_TYPE_ECDSA_P256=y
CONFIG_BOOT_SIGNATURE_KEY_FILE="root-ec-p256.pem"

# Validate primary slot on every boot
CONFIG_BOOT_VALIDATE_SLOT0=y

# Vector table relocation: Update VTOR when jumping from BFM to PFM
CONFIG_BOOT_INTR_VEC_RELOC=y

# Serial console for MCUboot log output
CONFIG_SERIAL=y
CONFIG_UART_CONSOLE=y
CONFIG_CONSOLE=y
CONFIG_LOG=y
CONFIG_MCUBOOT_LOG_LEVEL_INF=y
CONFIG_LOG_MODE_MINIMAL=y

# GPIO for LED visual feedback
CONFIG_GPIO=y

# MCUboot needs the flash map to find partitions
CONFIG_FLASH_MAP=y

# Required by the flash driver (nvmctrl-g3) which uses k_sem for ISR synchronization.
# MCUboot defaults this to y, so this is redundant but kept explicit for clarity.
CONFIG_MULTITHREADING=y

# Sector count: slot0 = 0xFC000 / 0x1000 = 252 sectors.
# Auto-calculation fails because partitions are under the controller node
# (not under a soc-nv-flash node).  Set manually.
CONFIG_BOOT_MAX_IMG_SECTORS_AUTO=n
CONFIG_BOOT_MAX_IMG_SECTORS=256
```

## drivers/Kconfig
```kconfig
# Copyright (c) 2026 Microchip Technology Inc.
# SPDX-License-Identifier: Apache-2.0

# Out of tree drivers configuration options

menu "Device Drivers"


endmenu
```
