/*
 * Copyright (c) 2026 Microchip Technology Inc.
 *
 * SPDX-License-Identifier: Apache-2.0
 */

/*
 * MCUboot DTS overlay.
 * Directs MCUboot to link against boot_partition.
 *
 * Auto-discovered by sysbuild as ${APP_DIR}/sysbuild/mcuboot.overlay.
 */

/ {
	chosen {
		zephyr,flash = &flash0;
		zephyr,code-partition = &boot_partition;
	};
};
