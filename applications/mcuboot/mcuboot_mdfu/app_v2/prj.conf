## CMakeLists.txt
```
# Copyright (c) 2026 Microchip Technology Inc.
# SPDX-License-Identifier: Apache-2.0

cmake_minimum_required(VERSION 3.20.0)

find_package(Zephyr REQUIRED HINTS $ENV{ZEPHYR_BASE})

project(mcuboot_mdfu_app_v2)

# Add parent directory to include path for app_common.h and uart_dfu/
target_include_directories(app PRIVATE ${CMAKE_CURRENT_SOURCE_DIR}/..)

target_sources(app PRIVATE
    src/main.c
    ../uart_dfu/uart_dfu.c
)
```

## prj.conf
```kconfig
# Copyright (c) 2026 Microchip Technology Inc.
# SPDX-License-Identifier: Apache-2.0

# MCUboot Application - Common Configuration
#
# Board-specific settings are in boards/<board>.conf

# Enable MCUboot support - adds 0x200 header offset
CONFIG_BOOTLOADER_MCUBOOT=y

# Enable MCUboot image manager for firmware upgrade state detection
CONFIG_IMG_MANAGER=y

# Enable MCUboot bootutil library for boot_write_img_confirmed()
CONFIG_MCUBOOT_BOOTUTIL_LIB=y

CONFIG_FLASH=y
CONFIG_FLASH_MAP=y
CONFIG_STREAM_FLASH=y
CONFIG_STREAM_FLASH_ERASE=y

# MDFU (Microchip Device Firmware Update) over UART: interrupt-driven RX into a
# ring buffer, so the FIFO-less UART RX register is not overrun at 115200.
CONFIG_UART_INTERRUPT_DRIVEN=y
CONFIG_RING_BUFFER=y

# GPIO for LED control
CONFIG_GPIO=y

# Enable serial console for UART output
CONFIG_SERIAL=y
CONFIG_CONSOLE=y
CONFIG_UART_CONSOLE=y
CONFIG_PRINTK=y

# Minimal kernel configuration
CONFIG_MAIN_STACK_SIZE=2048

# Enable system reboot for auto-restart after upgrade request
CONFIG_REBOOT=y

# Thread diagnostics and stack safety
CONFIG_THREAD_NAME=y          # Required for k_thread_name_set() to actually store the name
CONFIG_THREAD_MONITOR=y       # Enables runtime thread enumeration (kernel threads shell, thread_analyzer)
CONFIG_THREAD_STACK_INFO=y    # Exposes stack bounds per thread (needed for stack usage reporting)
CONFIG_INIT_STACKS=y          # Pre-fills stacks with 0xAA so high-water-mark is accurate
CONFIG_HW_STACK_PROTECTION=y  # MPU-based stack overflow guard (board has CONFIG_ARM_MPU=y)
```

## boards/pic32cx_sg41_cult.conf
```kconfig
# Copyright (c) 2026 Microchip Technology Inc.
# SPDX-License-Identifier: Apache-2.0

# PIC32CX SG41 Curiosity Ultra board-specific application settings

# MCUboot image signing (ECDSA-P256 test key, matches MCUboot's verification key)
CONFIG_MCUBOOT_SIGNATURE_KEY_FILE="bootloader/mcuboot/root-ec-p256.pem"
```

## boards/pic32cx_sg61_cult.conf
```kconfig
# Copyright (c) 2026 Microchip Technology Inc.
# SPDX-License-Identifier: Apache-2.0

# PIC32CX SG61 Curiosity Ultra board-specific application settings

# MCUboot image signing (ECDSA-P256 test key, matches MCUboot's verification key)
CONFIG_MCUBOOT_SIGNATURE_KEY_FILE="bootloader/mcuboot/root-ec-p256.pem"
```

## src/main.c
```c
/*
 * Copyright (c) 2026 Microchip Technology Inc.
 *
 * SPDX-License-Identifier: Apache-2.0
 */

/*
 * MCUboot Demo Application v2.0.0 - FAST BLINK
 *
 * This is the upgraded firmware - LED blinks FAST (250ms)
 * Downgrade prevention is enabled - cannot rollback to v1.0.0
 *
 * Firmware Upgrade Demo:
 *   - Press SW button OR enter 'y' via serial to upgrade to v3.0.0
 *     (requires a v3 image already present in slot1)
 *   - Enter 'u' via serial to receive a new image over MDFU (UART) and
 *     then automatically upgrade
 *   - You can flash app_v3 to slot1 and trigger update from here
 *
 * State Machine Architecture:
 *   - APP_STATE_INIT:          Initialize peripherals and confirm image
 *   - APP_STATE_SERVICE_TASKS: Monitor inputs and blink LED
 *   - APP_STATE_DFU_RECEIVE:   Receive upgrade image via MDFU protocol (UART)
 *   - APP_STATE_TRIGGER_UPDATE: Request upgrade and reboot
 */

#include "app_common.h"
#include "uart_dfu/uart_dfu.h"

#define APP_VERSION        2
#define TARGET_VERSION     3
#define BLINK_INTERVAL_MS  250   /* v2: FAST blink */

/* LED0 (GREEN) */
#define LED0_NODE DT_ALIAS(led0)
static const struct gpio_dt_spec led0 = GPIO_DT_SPEC_GET(LED0_NODE, gpios);

/* SW0 button */
#define SW0_NODE DT_ALIAS(sw0)
static const struct gpio_dt_spec button = GPIO_DT_SPEC_GET(SW0_NODE, gpios);

/* UART for serial input */
static const struct device *uart_dev = DEVICE_DT_GET(DT_CHOSEN(zephyr_console));

/* Application data */
static app_data_t app_data;

/* DFU receive thread — runs uart_dfu_receive() off the main thread so the
 * rest of the application (LED blink, watchdog, etc.) keeps running during
 * the transfer, which can take tens of seconds.
 */
#define DFU_THREAD_STACK_SIZE  2048
#define DFU_THREAD_PRIORITY    7

K_THREAD_STACK_DEFINE(dfu_thread_stack, DFU_THREAD_STACK_SIZE);
static struct k_thread dfu_thread_data;
static int dfu_rc;

static void uart_dfu_thread_fn(void *arg0, void *arg1, void *arg2)
{
	ARG_UNUSED(arg1);
	ARG_UNUSED(arg2);
	dfu_rc = uart_dfu_receive((const struct device *)arg0);
}

/* Application state machine */


/* Time to wait at boot so the user can (re)attach the serial monitor after the
 * MCUboot swap before the banner prints. */
#define APP_STARTUP_DELAY_MS 10000

static void app_state_init(void)
{
	/* Startup LED sequence */
	app_startup_blink(&led0);

	/* After an MCUboot swap the USB serial port drops; give the user time to
	 * reconnect their terminal before the banner prints. Blink slowly while
	 * waiting so the board is visibly alive. */
	for (int i = 0; i < (APP_STARTUP_DELAY_MS / 200); i++) {
		gpio_pin_set_dt(&led0, i % 2);
		k_msleep(200);
	}

	/* Allow GPIO to stabilize */
	k_msleep(100);

	/* Display banner */
	printk("\n");
	printk("MCUboot Demo v%d.0.0 - Fast Blink (250ms)\n", app_data.current_version);
	printk("Upgrade successful!\n");
	printk("Press SW or 'y' to upgrade to v%d.0.0 (slot1 must be pre-loaded)\n",
	       app_data.target_version);
	printk("Press 'u' to receive upgrade image via MDFU (pymdfu host)\n");
	printk("\n");

	/* Confirm current image to prevent rollback */
	app_confirm_image(app_data.current_version);
}

static app_action_t app_state_service_tasks(void)
{
	static int led_state = 0;
	uint8_t uart_char;

	/* Toggle LED */
	led_state = !led_state;
	gpio_pin_set_dt(&led0, led_state);

	/* Check button press (gpio_pin_get_dt() returns 1 when pressed) */
	if (!app_data.update_requested && gpio_pin_get_dt(&button) == 1) {
		/* Debounce */
		k_msleep(50);
		/* Confirm press */
		if (gpio_pin_get_dt(&button) == 1) {
			return APP_ACTION_UPGRADE;  /* Skip sleep, trigger now */
		}
	}

	/* Check serial input */
	if (!app_data.update_requested && uart_poll_in(uart_dev, &uart_char) == 0) {
		if (uart_char == 'y' || uart_char == 'Y') {
			return APP_ACTION_UPGRADE;  /* Skip sleep, trigger now */
		}
		if (uart_char == 'u' || uart_char == 'U') {
			return APP_ACTION_DFU_RECEIVE;  /* Enter MDFU receive mode */
		}
	}

	k_msleep(app_data.blink_interval_ms);
	return APP_ACTION_NONE;
}

/* Main application function */
int main(void)
{
	/* Initialize application data */
	app_data.state = APP_STATE_INIT;
	app_data.update_requested = false;
	app_data.current_version = APP_VERSION;
	app_data.target_version = TARGET_VERSION;
	app_data.blink_interval_ms = BLINK_INTERVAL_MS;

	/* Configure peripherals */
	gpio_pin_configure_dt(&led0, GPIO_OUTPUT_ACTIVE);
	gpio_pin_configure_dt(&button, GPIO_INPUT);

	/* Main application loop */
	while (1) {
		switch (app_data.state) {
		case APP_STATE_INIT:
			app_state_init();
#ifdef CONFIG_APP_MDFU_AUTO_ENTER
			/* TEST ONLY: skip the 'u' keypress and go straight to
			 * MDFU receive mode so pymdfu can connect right after reset.
			 */
			app_data.state = APP_STATE_DFU_RECEIVE;
#else
			/* Transition to service tasks */
			app_data.state = APP_STATE_SERVICE_TASKS;
#endif
			break;

		case APP_STATE_SERVICE_TASKS:
			switch (app_state_service_tasks()) {
			case APP_ACTION_UPGRADE:
				app_data.update_requested = true;
				/* Slot1 already loaded: request the swap. */
				app_data.state = APP_STATE_TRIGGER_UPDATE;
				break;
			case APP_ACTION_DFU_RECEIVE:
				app_data.state = APP_STATE_DFU_RECEIVE;
				break;
			default:
				break;
			}
			break;

		case APP_STATE_DFU_RECEIVE:
			printk("\nMDFU: waiting for host to start image transfer...\n");
			/* printk() drains synchronously (uart_poll_out per char), so the
			 * TX buffer is empty before the thread installs the UART ISR.
			 */
			k_thread_create(&dfu_thread_data, dfu_thread_stack,
					K_THREAD_STACK_SIZEOF(dfu_thread_stack),
					uart_dfu_thread_fn,
					(void *)uart_dev, NULL, NULL,
					DFU_THREAD_PRIORITY, 0, K_NO_WAIT);
			k_thread_name_set(&dfu_thread_data, "dfu_receive");
			app_data.state = APP_STATE_DFU_WAITING;
			break;

		case APP_STATE_DFU_WAITING:
			if (k_thread_join(&dfu_thread_data, K_NO_WAIT) == 0) {
				if (dfu_rc == 0) {
					printk("Transfer complete - upgrading to v%d.0.0...\n",
					       app_data.target_version);
					app_data.update_requested = true;
					app_data.state = APP_STATE_TRIGGER_UPDATE;
				} else {
#ifdef CONFIG_APP_MDFU_AUTO_ENTER
					/* TEST ONLY: re-arm so the host can connect again. */
					app_data.state = APP_STATE_DFU_RECEIVE;
#else
					printk("DFU transfer failed - resuming normal operation\n\n");
					app_data.state = APP_STATE_SERVICE_TASKS;
#endif
				}
			} else {
				/* Transfer in progress — keep LED alive while waiting. */
				gpio_pin_toggle_dt(&led0);
				k_msleep(500);
			}
			break;

		case APP_STATE_TRIGGER_UPDATE:
			app_trigger_update(&led0, app_data.target_version);
			/* app_trigger_update() never returns (system resets) */
			break;

		default:
			/* Should never reach here */
			printk("ERROR: Invalid state %d\n", app_data.state);
			app_data.state = APP_STATE_INIT;
			break;
		}
	}

	return 0;
}
```
